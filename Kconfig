## Kconfig
```kconfig
source "arch/Kconfig"

source "module/Kconfig"

source "kernel/Kconfig"

source "lib/Kconfig"
```

## arch/riscv/Kconfig
```kconfig
config ARCH_RISCV
    bool "riscv arch"
    default y
    select RISCV_INIT_STACK_OPTION
    help
      sign for riscv arch target
      do not change this

config RISCV_INIT_STACK_OPTION
    bool "riscv init stack optional"
    default n
    help
      riscv kernel init stack config,
      this is optional

config RISCV_INIT_STACKSIZE
    int "riscv init stack size"
    default 8192
    depends on RISCV_INIT_STACK_OPTION
    help
      init stack size config

source "arch/$(ARCH)/boot/Kconfig"

#use a menu trick to select ARCH_RISCV
#do not let user to change it
menu "trick"
visible if False
    config TEST_12367612039
        bool "test"
        default y
        select ARCH_RISCV
endmenu

source "arch/$(ARCH)/board/Kconfig"
```

## arch/riscv/board/Kconfig
```kconfig
choice
    prompt "riscv board select"
    default QEMU_RV64
    
    config QEMU_RV64
        bool "qemu-virt-rv64"
        help
          riscv64 board , qemu virt
endchoice

### trick menu
### not visible

menu "trick"
visible if False
    config DTS_PATH
        string "dts abs path"
        default "$(src_tree)/arch/$(ARCH)/board/qemu_rv64" if QEMU_RV64

endmenu
```

## arch/riscv/boot/Kconfig
```kconfig
config BOOT_SMP
    def_bool n
    prompt "smp boot"
    help
     config for open smp boot
     smp boot : more than two cpu will excute
     "_start" function when firmware done at
     the same time, normally we do not need this
     because the firmware opensbi will only let one
     cpu excute the next stage code (here we are "_start"
     function) , if we want to boot other cpu, boot it
     through opensbi
```

## arch/riscv/mm/Kconfig
```kconfig
menu "mm configuration"

config PAGE_OFFSET
    int "memory page offset"
    default 12
    help
      page offset of the system 
      page size is (1 << PAGE_OFFSET) byte
      that means page size must be 2-align byte

endmenu
```

## kernel/Kconfig
```kconfig
menu "kernel configuration"

config DEBUG_ASSERTION
    bool "assertion debug config"
    default y
    help
      open this config, we will add
      assertion to promise the kernel
      is run correctly, this is helpful
      for debug, open this will leads to more
      kernel panic situation
endmenu 
```

## lib/Kconfig
```kconfig
menu "lib configuration"

config LIB_FDT
    prompt "fdt lib"
    def_bool y
    help
      open lib fdt api
      if opened , you can use 
      api/macro in "aco/libfdt.h"
      if not, you can't use these

endmenu
```

## mem/Kconfig
```kconfig
menu "mm configuration"

config PAGE_OFFSET
    int "memory page offset"
    default 12
    help
      page offset of the system 
      page size is (1 << PAGE_OFFSET) byte
      that means page size must be 2-align byte

config MEM_BLOCK_ALOCTOR
    bool "mem_block api"
    default n
    help
      open this config, we can use
      mem_block allocator api.
      default not open, we can also
      use its api but do nothing

source "mem/buddy/Kconfig"

endmenu
```

## module/Kconfig
```kconfig
menu "Module Configuration"

source "module/rttest/Kconfig"

source "module/log/Kconfig"

source "module/mm/Kconfig"

endmenu
```

## module/log/Kconfig
```kconfig
menu "module log_system"

config LOG_MODULE
    def_bool y
    prompt "log module"
    help
      if we open log module,
      we can use apis in log.h,
      otherwise we also can use apis in log.h,
      but do nothing

config LOG_USE_COLOR
    def_bool y
    prompt "log color"
    depends on LOG_MODULE
    help
      if we open log_use_color,
      all log info will be printed 
      colorful

config LOG_STDBUFFERSIZE
    int    "log stdout bufer_size"
    default 1024
    depends on LOG_MODULE
    help 
      log module stdout buffer size

choice
    prompt "log level"
    default LOG_LEVEL_TRACE
    depends on LOG_MODULE
    help
      log level choose

    config LOG_LEVEL_TRACE
	bool "trace"

    config LOG_LEVEL_DEBUG
        bool "debug"

    config LOG_LEVEL_INFO
        bool "info"

    config LOG_LEVEL_WARN
        bool "warn"

    config LOG_LEVEL_ERROR
        bool "error"

    config LOG_LEVEL_FATAL
        bool "fatal"
endchoice

endmenu
```

## module/mm/allocators/Kconfig
```kconfig
menu "mm allocators api"

config MEM_BLOCK_ALOCTOR
    bool "mem_block api"
    default n
    help
      open this config, we can use
      mem_block allocator api.
      default not open, we can also
      use its api but do nothing

endmenu
```

## module/mm/buddy/Kconfig
```kconfig
menu "buddy_system configuration"

config BUDDYSYSTEM_MAX_ORDER
    int "buddy max order"
    default 6
    help
      configuration for buddy system
      max order
endmenu 
```

## module/rttest/Kconfig
```kconfig
menu "module runtime_test"

config RTTEST
    prompt "runtime-test"
    def_bool n
    select TEST_HELLO
    select TEST_INIT_SECTION
    help
      kernel run time test module
      if we open this , all test function will
      be executed

config TEST_HELLO
    prompt "hello test"
    def_bool y
    depends on RTTEST
    help
      hello world test 

config TEST_INIT_SECTION
    prompt "init_sec test"
    def_bool y
    depends on RTTEST
    help
      runtime test for sections (.bss : all 0
      .data : value and so on)

config TEST_LIBSTR
    prompt "lbstr test"
    def_bool y
    depends on RTTEST
    help
      runtime test for lib/string.c

config TEST_LIST_API
    prompt "list api test"
    def_bool y
    depends on RTTEST
    help
      struct list_head api(copied from linux)
      runtime test

config TEST_PAGE_API
    prompt "page api test"
    def_bool y
    depends on RTTEST
    help
      test all api/macro used in "mm/page.h"
      if there is api/macro changed , remember
      to add/fix the test code

config TEST_PGFM_API
    prompt "pgfm api test"
    def_bool y
    depends on RTTEST
    help
      test all api/macro used in "mm/pageframe.h"
      if there is api/macro changed, remember 
      to add/fix the test code

config TEST_CPU_API
    prompt "cpu api test"
    def_bool y
    depends on RTTEST
    help
      test all api/macro used in "aco/cpu.h"
      if there is api/macro changed, remember
      to add/fix the test code

config TEST_MEMBLOCK_API
    prompt "memblock api test"
    def_bool y
    depends on RTTEST
    help 
      test all api/macro used in "mm/memblock_alloc.h"
      if there is api/macro changed, remember
      to add/fix the test code

config TEST_BUDDY_API
    prompt "buddy api test"
    def_bool y
    depends on RTTEST
    help
      test all api/macro used in "mm/buddy.h"
      if there is api/macro changed, remember
      to add/fix the test code

config TEST_ATOMIC_API
    prompt "atomic api test"
    def_bool y
    depends on RTTEST
    help
      test all api/macro used in "aco/atomic.h"
      if there is api/macro changed, remember
      to add/fix the test code

config TEST_SPINLOCK_API
    prompt "spinlk api test"
    def_bool y
    depends on RTTEST
    help
      test all api/macro used in "aco/spinlock.h"
      if there is api/macro changed, remember
      to add/fix the test code

config TEST_RWLOCK_API
    prompt "rwlock api test"
    def_bool y
    depends on RTTEST
    help
      test all api/macro used in "aco/rwlock.h"
      if there is api/macro changed, remember
      to add/fix the test code

config TEST_SLAB_API
    prompt "slab api test"
    def_bool y
    depends on RTTEST
    help
      test all api/macro used in "mm/slab.h"
      if there is api/macro changed, remember
      to add/fix the test code

endmenu
```
